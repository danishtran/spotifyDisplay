## yocto/build-rpi/conf/bblayers.conf
```bitbake
# POKY_BBLAYERS_CONF_VERSION is increased each time build/conf/bblayers.conf
# changes incompatibly
POKY_BBLAYERS_CONF_VERSION = "2"

BBPATH = "${TOPDIR}"
BBFILES ?= ""

BBLAYERS ?= " \
  {Path}/yocto/poky/meta \
  {Path}/yocto/poky/meta-poky \
  {Path}/poky/meta-yocto-bsp \
  {Path}/yocto/meta-openembedded/meta-oe \
  {Path}/yocto/meta-openembedded/meta-python \
  {Path}/yocto/meta-raspberrypi \
  {Path}/yocto/meta-custom \
  "
```
